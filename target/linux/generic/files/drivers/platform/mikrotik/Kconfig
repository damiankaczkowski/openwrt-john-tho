## target/linux/generic/files/drivers/platform/mikrotik/Kconfig
```kconfig
menuconfig MIKROTIK
	bool "Platform support for MikroTik RouterBoard virtual devices"
	help
	  Say Y here to get to see options for the MikroTik RouterBoard platform.
	  This option alone does not add any kernel code.


if MIKROTIK

config MIKROTIK_RB_SYSFS
	tristate "RouterBoot sysfs support"
	depends on MTD
	select LZO_DECOMPRESS
	select CRC32
	help
	  This driver exposes RouterBoot configuration in sysfs.

config MIKROTIK_RB_SYSFS_WLAN_LZ77
	tristate "RouterBoot sysfs WLAN BRD LZ77 decode support"
	depends on MIKROTIK_RB_SYSFS
	help
	  Include the capability to decode wireless board data from
	  Mikrotik's LZ77 format. This was first seen in 2021.
	  Likely required if device is using RouterBOOT v7 for backup bootloader,
	  or was recently calibrated (example: US radio limits).

endif # MIKROTIK
```
